## Core/Modified_OpenSource/Kernel_5_Config-ARM-AST2600-ArcherCity-src/kernel.its
```
/dts-v1/;

/ {
        description = "U-Boot fitImage for LTS13 SPX/5.4.85-ami/ast2600";
        #address-cells = <1>;

        images {
                kernel@1 {
                        description = "Linux kernel";
                        data = /incbin/("arch/arm/boot/zImage");
                        type = "kernel";
                        arch = "arm";
                        os = "linux";
                        compression = "none";
                        load = <0x80001000>;
                        entry = <0x80001000>;
                        hash@1 {
                                algo = "sha256";
                        };
                };
                fdt@ArcherCity.dtb {
                        description = "Flattened Device Tree blob";
                        data = /incbin/("arch/arm/boot/dts/ArcherCity.dtb");
                        type = "flat_dt";
                        arch = "arm";
                        compression = "none";
                        
                        hash@1 {
                                algo = "sha256";
                        };
                };
              
	};

        configurations {
                default = "conf@ArcherCity.dtb";
                conf@ArcherCity.dtb {
			description = "1 Linux kernel, FDT blob";
			kernel = "kernel@1";
			fdt = "fdt@ArcherCity.dtb";
			
			
                        hash@1 {
                                algo = "sha256";
                        };
                };
                
	};
};
```
